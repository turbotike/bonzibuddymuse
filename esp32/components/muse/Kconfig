## esp32/components/muse/Kconfig
```kconfig
# Copyright (c) Meta Platforms, Inc. and affiliates.
#
# Licensed under the Apache License, Version 2.0 (the "License");
# you may not use this file except in compliance with the License.
# You may obtain a copy of the License at
#
#     http://www.apache.org/licenses/LICENSE-2.0
#
# Unless required by applicable law or agreed to in writing, software
# distributed under the License is distributed on an "AS IS" BASIS,
# WITHOUT WARRANTIES OR CONDITIONS OF ANY KIND, either express or implied.
# See the License for the specific language governing permissions and
# limitations under the License.

menu "Muse"

    choice MUSE_BOARD
        prompt "Board with the full UI"
        default MUSE_BOARD_NONE
        help
            The UI is the voice companion on boards with a screen: an
            animated avatar, push-to-talk chat, settings, and battery
            handling. It runs beside Home Link, which owns Wi-Fi, BLE
            pairing, credentials and OTA. Pick the board it runs on, or none
            for a Link without a display.

        config MUSE_BOARD_NONE
            bool "None (Home Link without a display)"

        config MUSE_BOARD_WAVESHARE_S3_175C
            bool "Waveshare ESP32-S3-Touch-AMOLED-1.75C"
            depends on IDF_TARGET_ESP32S3

        config MUSE_BOARD_WAVESHARE_S3_175
            bool "Waveshare ESP32-S3-Touch-AMOLED-1.75 (not the 1.75C)"
            depends on IDF_TARGET_ESP32S3

        config MUSE_BOARD_AIPI
            bool "AIPI Lite (ESP32-S3, two buttons, no touch)"
            depends on IDF_TARGET_ESP32S3

        config MUSE_BOARD_ESPRESSIF_BOX_3
            bool "Espressif ESP32-S3-BOX-3 (320x240 touch LCD, speaker and microphones)"
            depends on IDF_TARGET_ESP32S3

        config MUSE_BOARD_WAVESHARE_C6_18
            bool "Waveshare ESP32-C6-Touch-AMOLED-1.8"
            depends on IDF_TARGET_ESP32C6

        config MUSE_BOARD_SENSECAP_WATCHER
            bool "Seeed SenseCAP Watcher (ESP32-S3, round touch LCD, wheel)"
            depends on IDF_TARGET_ESP32S3

        config MUSE_BOARD_M5STACK_CARDPUTER_ADV
            bool "M5Stack Cardputer ADV (ESP32-S3, keyboard, no PSRAM)"
            depends on IDF_TARGET_ESP32S3

        config MUSE_BOARD_M5STACK_STICKS3
            bool "M5Stack StickS3 (ESP32-S3, two buttons, no touch)"
            depends on IDF_TARGET_ESP32S3

        config MUSE_BOARD_M5STACK_STICKC_PLUS2
            bool "M5Stack StickC Plus2 (ESP32, two buttons, no touch)"
            depends on IDF_TARGET_ESP32

        config MUSE_BOARD_M5STACK_STOPWATCH
            bool "M5Stack StopWatch (ESP32-S3, round touch AMOLED)"
            depends on IDF_TARGET_ESP32S3

        config MUSE_BOARD_M5STACK_CORES3
            bool "M5Stack CoreS3 (ESP32-S3, 320x240 touch LCD, speaker and microphones)"
            depends on IDF_TARGET_ESP32S3
        config MUSE_BOARD_FREENOVE_S3_28
            bool "Freenove ESP32-S3 Display 2.8 (FNK0104, 240x320 touch LCD, ES8311 speaker and mic)"
            depends on IDF_TARGET_ESP32S3
        config MUSE_BOARD_FREENOVE_S3_35
            bool "Freenove ESP32-S3 Display 3.5 (FNK0104N, 320x480 QSPI touch LCD, ES8311 speaker and mic)"
            depends on IDF_TARGET_ESP32S3
    endchoice

    config MUSE_ENABLED
        bool
        default y if !MUSE_BOARD_NONE

    # Always defined, unlike the target-dependent board options, so
    # idf_component.yml rules can select each board's managed components.
    config MUSE_BOARD_ID
        string
        default "waveshare_s3_175c" if MUSE_BOARD_WAVESHARE_S3_175C
        default "waveshare_s3_175" if MUSE_BOARD_WAVESHARE_S3_175
        default "aipi" if MUSE_BOARD_AIPI
        default "espressif_box_3" if MUSE_BOARD_ESPRESSIF_BOX_3
        default "waveshare_c6_18" if MUSE_BOARD_WAVESHARE_C6_18
        default "sensecap_watcher" if MUSE_BOARD_SENSECAP_WATCHER
        default "m5stack_sticks3" if MUSE_BOARD_M5STACK_STICKS3
        default "m5stack_stickc_plus2" if MUSE_BOARD_M5STACK_STICKC_PLUS2
        default "m5stack_cardputer_adv" if MUSE_BOARD_M5STACK_CARDPUTER_ADV
        default "m5stack_stopwatch" if MUSE_BOARD_M5STACK_STOPWATCH
        default "m5stack_cores3" if MUSE_BOARD_M5STACK_CORES3
        default "freenove_s3_28" if MUSE_BOARD_FREENOVE_S3_28
        default "freenove_s3_35" if MUSE_BOARD_FREENOVE_S3_35
        default "none"

    # The Muse tools' serial port: the console UART behind the board's USB
    # bridge, where the chip's own USB Serial/JTAG isn't wired to a connector
    # (the Watcher's USB-C goes to a CH342) or the chip has none.
    config MUSE_CONSOLE_UART
        bool
        default y if MUSE_BOARD_SENSECAP_WATCHER || !SOC_USB_SERIAL_JTAG_SUPPORTED

    # A board overlay can raise this for a quiet speaker.
    config MUSE_DEFAULT_VOLUME
        int "Speaker volume until one is chosen in settings (percent)"
        range 0 100
        default 70

    config MUSE_WATCHER_CAMERA
        bool "SenseCAP Watcher camera capture and live preview"
        depends on MUSE_BOARD_SENSECAP_WATCHER && SPIRAM
        default n
        help
            Enable the camera.capture Home Link command and the wheel
            double-click camera preview. Camera buffers and tasks consume
            memory and preview decoding shares CPU time with voice and Link.
            Leave disabled to build without camera support.

    config MUSE_SKIN_WINAMP
        bool "Winamp 2.x look for the settings pages"
        depends on MUSE_ENABLED
        default n
        help
            Grey plastic body, raised bevels, sunken black wells and green
            LCD text in the 8 px pixel font, the way a classic Winamp skin
            draws its playlist editor. Made for small flat panels.

    config MUSE_CHAT_SESSION_ID
        string "Side chat for this gadget's turns (a UUID; empty = the main chat)"
        depends on MUSE_ENABLED
        default ""
        help
            Sent as "session_id" with every turn, the way the Linux SDK's
            send-user-msg --session-id does: an id Muse hasn't seen starts a
            side chat in the app and the gadget's turns stay there, out of
            your main chat. Any UUID will do (python -c "import uuid;
            print(uuid.uuid4())"). Empty posts to the main chat as before.

    config MUSE_GADGET_TOOLS
        bool "Gadget tools Muse can call: screen text, sounds, timers, alarms, clock, light, status"
        depends on MUSE_ENABLED && MUSE_HATCH
        default n
        help
            Offers Muse what the board can do on its own as Home Link
            commands (main/gadget_tools.c): a message on the screen, a
            synthesised chime or alarm, countdowns and clock alarms that
            show while they run, local time over SNTP, the RGB light,
            the room's sound level, settings and a status report.

    config MUSE_PET
        bool "The pet: a creature that lives on the gadget, with Muse as its spirit"
        depends on MUSE_GADGET_TOOLS
        default n
        help
            A virtual pet (components/muse/pet.c) drawn by the avatar renderer
            from its genome: needs, sleep, growth through stages, sickness, all
            on the board and saved in NVS. Muse gets reports and speaks for it
            through the pet.* commands (main/gadget_pet.c).

    config MUSE_PET_REPORT_MIN
        int "Minutes between the pet's routine reports to Muse (0: only events)"
        depends on MUSE_PET
        range 0 1440
        default 90

    config MUSE_TOOLS_RGB_LED_GPIO
        int "WS2812 RGB LED GPIO for light.set (-1: none)"
        depends on MUSE_GADGET_TOOLS
        range -1 48
        default -1

    config MUSE_TOOLS_TZ
        string "POSIX TZ string for the clock and alarms"
        depends on MUSE_GADGET_TOOLS
        default "UTC0"
        help
            For example MST7MDT,M3.2.0,M11.1.0 (Mountain), EST5EDT,M3.2.0,M11.1.0
            (Eastern), GMT0BST,M3.5.0/1,M10.5.0 (UK), CET-1CEST,M3.5.0,M10.5.0/3.

    config MUSE_TOOLS_GPIO_ALLOW
        string "GPIO pins Muse may drive or read (comma separated; empty: no gpio.* commands)"
        depends on MUSE_GADGET_TOOLS
        default ""
        help
            Only these pins are accepted by gpio.set / gpio.pulse / gpio.read. List
            the spare header pins of the board, never ones the display, codec,
            card or button use. Anything wired to them belongs on a proper board.

    config MUSE_TOOLS_SD_CLK
        int "microSD CLK GPIO (-1: no card slot)"
        depends on MUSE_GADGET_TOOLS
        range -1 48
        default -1

    config MUSE_TOOLS_SD_CMD
        int "microSD CMD GPIO"
        depends on MUSE_GADGET_TOOLS
        range -1 48
        default -1

    config MUSE_TOOLS_SD_D0
        int "microSD D0 GPIO"
        depends on MUSE_GADGET_TOOLS
        range -1 48
        default -1

    config MUSE_TOOLS_SD_D1
        int "microSD D1 GPIO (-1: 1-bit mode)"
        depends on MUSE_GADGET_TOOLS
        range -1 48
        default -1

    config MUSE_TOOLS_SD_D2
        int "microSD D2 GPIO"
        depends on MUSE_GADGET_TOOLS
        range -1 48
        default -1

    config MUSE_TOOLS_SD_D3
        int "microSD D3 GPIO"
        depends on MUSE_GADGET_TOOLS
        range -1 48
        default -1

    config MUSE_SERIAL_VOICE
        bool "Serial voice link: a host on the USB cable speaks through the gadget"
        depends on MUSE_ENABLED && MUSE_HATCH
        default n
        help
            devices/SERIAL_VOICE.md. The console accepts SHOW <text>, RATE <hz>,
            SAY <n> (then READY, then n bytes of s16le mono PCM) and END, plays
            the PCM through the speaker with the speaking face, and writes every
            reply's text as an @chat frame of type "reply" so the host can
            synthesise it. For a Raspberry Pi running a local voice engine.

    config MUSE_VOICE_LINK_PORT
        int "TCP/UDP port of the voice link over Wi-Fi"
        depends on MUSE_SERIAL_VOICE
        range 1024 65535
        default 7343

    config MUSE_VOICE_LINK_KEY
        string "Key a network client must send (AUTH <key>) before CHAT; empty: no key"
        depends on MUSE_SERIAL_VOICE
        default ""

    config MUSE_AVATAR_FULL_REDRAW
        bool "Redraw the whole avatar every frame (sprite avatars, not drawn in 64x64 cells)"
        depends on MUSE_ENABLED
        default n

    config MUSE_HATCH
        bool "Muse's own voice session"
        depends on MUSE_ENABLED
        default y if SPIRAM
        default n
        help
            Push-to-talk turns go over a voice session of Muse's own, to the
            VM Home Link is paired with or one set up on the device with a
            device token. Replies are text, shown as captions; start_tts in
            muse_chat_session.cpp is where a TTS API of your own can speak
            them. Needs PSRAM. Without it, voice notes go over Home Link's own
            session to its paired VM and replies are shown as text.

endmenu
```
